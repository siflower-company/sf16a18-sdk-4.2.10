## linux-3.18.29-dev/linux-3.18.29/arch/mips/siflower/Kconfig
```kconfig
if SIFLOWER

choice
	prompt "Siflower SoC selection"
	default SOC_SF16A18
	help
	  Select Siflower MIPS SoC type.

	config SOC_SF16A18
		bool "SF16A18"

	config SOC_SF19A28
		bool "SF19A28"

endchoice

if SOC_SF16A18

choice
	prompt "Siflower SoC_SF16A18 selection"
	default SF16A18_MPW0
	help
	  Select MPW0/MPW1/FULL_MASK SF16A18 SoC

	config SF16A18_MPW0
		bool "SF16A18_MPW0"

	config SF16A18_MPW1
		bool "SF16A18_MPW1"

	config SF16A18_FULL_MASK
		bool "SF16A18_FULL_MASK"

endchoice

if SF16A18_MPW0

config DT_SF16A18_MPW0_P10
	bool "Built-in device tree for sf16a18 p10 boards"
	default n
	select BUILTIN_DTB
	help
	  Add an FDT blob for XLP EVP boards into the kernel.
	  This DTB will be used if the firmware does not pass in a DTB
	  pointer to the kernel.  The corresponding DTS file is at
	  arch/mips/boot/dts/sf16a18_mpw0_p10.dts

config DT_SF16A18_MPW0_P10_FLASH
	bool "Built-in device tree for sf16a18 p10 boards with flash optimize"
	default n
	select BUILTIN_DTB
	help
	  Add an FDT blob for XLP EVP boards into the kernel.
	  This DTB will be used if the firmware does not pass in a DTB
	  pointer to the kernel.  The corresponding DTS file is at
	  arch/mips/boot/dts/sf16a18_mpw0_p10_flash.dts

config DT_SF16A18_MPW0_P20
	bool "Built-in device tree for sf16a18 p20 boards"
	default n
	select BUILTIN_DTB
	help
	  Add an FDT blob for XLP EVP boards into the kernel.
	  This DTB will be used if the firmware does not pass in a DTB
	  pointer to the kernel.  The corresponding DTS file is at
	  arch/mips/boot/dts/sf16a18_mpw0_p20.dts

endif #SF16A18_MPW0

if SF16A18_MPW1

config DT_SF16A18_MPW1_FPGA
	bool "Built-in device tree for sf16a18 mpw1 fpga"
	default n
	select BUILTIN_DTB
	help
	  Add an FDT blob for XLP EVP boards into the kernel.
	  This DTB will be used if the firmware does not pass in a DTB
	  pointer to the kernel.  The corresponding DTS file is at
	  arch/mips/boot/dts/sf16a18_fpga_mpw1.dts

config DT_SF16A18_MPW1_P10
	bool "Built-in device tree for sf16a18 mpw1 p10 boards"
	default n
	select BUILTIN_DTB
	help
	  Add an FDT blob for XLP EVP boards into the kernel.
	  This DTB will be used if the firmware does not pass in a DTB
	  pointer to the kernel.  The corresponding DTS file is at
	  arch/mips/boot/dts/sf16a18_mpw1_p10.dts

config DT_SF16A18_MPW1_P20
	bool "Built-in device tree for sf16a18 mpw1 p20 boards"
	default n
	select BUILTIN_DTB
	help
	  Add an FDT blob for XLP EVP boards into the kernel.
	  This DTB will be used if the firmware does not pass in a DTB
	  pointer to the kernel.  The corresponding DTS file is at
	  arch/mips/boot/dts/sf16a18_mpw1_p20.dts

endif #SF16A18_MPW1

if SF16A18_FULL_MASK

config DT_SF16A18_FULLMASK_P10
	bool "Built-in device tree for sf16a18 full mask p10 boards"
	default n
	select BUILTIN_DTB
	help
	  Add an FDT blob for XLP EVP boards into the kernel.
	  This DTB will be used if the firmware does not pass in a DTB
	  pointer to the kernel.  The corresponding DTS file is at
	  arch/mips/boot/dts/sf16a18_fullmask_p10.dts

config DT_SF16A18_FULLMASK_P20
	bool "Built-in device tree for sf16a18 full mask p20 boards"
	default n
	select BUILTIN_DTB
	help
	  Add an FDT blob for XLP EVP boards into the kernel.
	  This DTB will be used if the firmware does not pass in a DTB
	  pointer to the kernel.  The corresponding DTS file is at
	  arch/mips/boot/dts/sf16a18_fullmask_p20.dts

config DT_SF16A18_FULLMASK_P10M
	bool "Built-in device tree for sf16a18 full mask p10m boards"
	default n
	select BUILTIN_DTB
	help
	  Add an FDT blob for XLP EVP boards into the kernel.
	  This DTB will be used if the firmware does not pass in a DTB
	  pointer to the kernel.  The corresponding DTS file is at
	  arch/mips/boot/dts/sf16a18_fullmask_p10m.dts

config DT_SF16A18_FULLMASK_P10_FLASH
	bool "Built-in device tree for sf16a18 p10 boards with flash optimize"
	default n
	select BUILTIN_DTB
	help
	  Add an FDT blob for XLP EVP boards into the kernel.
	  This DTB will be used if the firmware does not pass in a DTB
	  pointer to the kernel.  The corresponding DTS file is at
	  arch/mips/boot/dts/sf16a18_fullmask_p10_flash.dts

config DT_SF16A18_FULLMASK_86V
	bool "Built-in device tree for sf16a18 86v boards"
	default n
	select BUILTIN_DTB
	help
	  The corresponding DTS file is at
	  arch/mips/boot/dts/sf16a18_fullmask_86v.dts

config DT_SF16A18_FULLMASK_86V_C2
	bool "Built-in device tree for sf16a18 86v 2-layer boards"
	default n
	select BUILTIN_DTB
	help
	  The corresponding DTS file is at
	  arch/mips/boot/dts/sf16a18_fullmask_86v_c2.dts

config DT_SF16A18_FULLMASK_REP_V1
	bool "Built-in device tree for sf16a18 rep_v1 boards"
	default n
	select BUILTIN_DTB
	help
	  The corresponding DTS file is at
	  arch/mips/boot/dts/sf16a18_fullmask_rep_v1.dts

config DT_SF16A18_FULLMASK_REP_NOPA
	bool "Built-in device tree for sf16a18 rep_nopa boards"
	default n
	select BUILTIN_DTB
	help
	  The corresponding DTS file is at
	  arch/mips/boot/dts/sf16a18_fullmask_rep_nopa.dts

config DT_SF16A18_FULLMASK_ACCTL
	bool "Built-in device tree for sf16a18 full mask ac boards"
	default n
	select BUILTIN_DTB
	help
	  Add an FDT blob for XLP EVP boards into the kernel.
	  This DTB will be used if the firmware does not pass in a DTB
	  pointer to the kernel.  The corresponding DTS file is at
	  arch/mips/boot/dts/sf16a18_fullmask_ac.dts

config DT_SF16A18_FULLMASK_X10
	bool "Built-in device tree for sf16a18 full mask x10 boards"
	default n
	select BUILTIN_DTB
	help
	  Add an FDT blob for XLP EVP boards into the kernel.
	  This DTB will be used if the firmware does not pass in a DTB
	  pointer to the kernel.  The corresponding DTS file is at
	  arch/mips/boot/dts/sf16a18_fullmask_x10.dts

config DT_SF16A18_FULLMASK_P10H
	bool "Built-in device tree for sf16a18 full mask p10h boards"
	default n
	select BUILTIN_DTB
	help
	  Add an FDT blob for XLP EVP boards into the kernel.
	  This DTB will be used if the firmware does not pass in a DTB
	  pointer to the kernel.  The corresponding DTS file is at

config DT_SF16A18_FULLMASK_P10_8M
	bool "Built-in device tree for sf16a18 full mask p10 8m flash boards"
	default n
	select BUILTIN_DTB
	help
	  Add an FDT blob for XLP EVP boards into the kernel.
	  This DTB will be used if the firmware does not pass in a DTB
	  pointer to the kernel.  The corresponding DTS file is at
	  arch/mips/boot/dts/sf16a18_fullmask_p10_8m.dts

config DT_SF16A18_FULLMASK_EVB_V5
	bool "Built-in device tree for sf16a18 fullmask evb v5 boards"
	default n
	select BUILTIN_DTB
	help
	  Add an FDT blob for XLP EVP boards into the kernel.
	  This DTB will be used if the firmware does not pass in a DTB
	  pointer to the kernel.  The corresponding DTS file is at
	  arch/mips/boot/dts/sf16a18_fullmask_evb_v5.dts

config DT_SF16A18_FULLMASK_CPE
	bool "Built-in device tree for sf16a18 full mask 4g-wifi cpe boards"
	default n
	select BUILTIN_DTB
	help
	  This DTB will be used if the firmware does not pass in a DTB
	  pointer to the kernel.  The corresponding DTS file is at
	  arch/mips/boot/dts/sf16a18_fullmask_cpe.dts

endif #SF16A18_FULL_MASK

endif #SOC_SF16A18

if SOC_SF19A28

choice
	prompt "Siflower SoC_SF19A28 selection"
	default SF19A28_FULLMASK
	help
	  Select FULL_MASK SF19A28 SoC

	config SF19A28_FULLMASK
		bool "SF19A28_FULLMASK"

endchoice

if SF19A28_FULLMASK

config DT_SF19A28_FULLMASK_FPGA
	bool "Built-in device tree for sf19a28 fullmask fpga"
	default n
	select BUILTIN_DTB
	help
	  Add an FDT blob for XLP EVP boards into the kernel.
	  This DTB will be used if the firmware does not pass in a DTB
	  pointer to the kernel.  The corresponding DTS file is at
	  arch/mips/boot/dts/sf19a28_fullmask_fpga.dts

endif #SF19A28_FULLMASK

endif #SOC_SF19A28

config FIRMWARE_SIZE
	int "CORE 1 FIRMWARE SIZE (0-8192 KB)"
	range 0 8192
	default 1024
	help
	  This is the firmware size for core 1. If firmware size is
	  set to zero, core 1 will not be powered up.

config FIRMWARE_LOAD_BASE
	hex "CORE 1 FIRMWARE LOAD PHYSICAL BASE ADDRESS "
	range 0 0x10000000
	default 0x1400000
	help
	  This is the firmware physical base addr for core 1.

config CORE1_MEM_RES
	bool "CORE 1 MEM RESERVE"
	default n

config SIFLOWER_PWMTIMER_CLKSRC
	bool "Enable SiFlower PWM Timer based clocksource"
	depends on SOC_SF16A18
	select SFAX8_TIMER
	select CLKSRC_SFAX8_PWM
	select MIPS_EXTERNAL_TIMER
	help
	  This option enables a clocksource driver based on a SiFlower
	  PWM external timer.

	  If you want to enable the CPUFreq, you need to enable
	  this option.

	  If you don't want to enable CPUFreq, you can leave this disabled.

config SF_KERNEL_LITE
	bool "Enable SiFlower lite kernel for 4MB flash"
	default n
	help
	  This config enables 4MB flash optimize for SiFlower kernel
	  configs and drivers. It will disable some module features,
	  and only recommended for p10b.

config SF_IRQ_DEBUG
	bool "Enable calculating irq handle total time for debug."
	default n
	depends on SF16A18_FULL_MASK
	help
	  This config enables calculating the total time used for irq
	  handler to check if it's too long.

endif #SIFLOWER
```

## linux-3.18.29-dev/linux-3.18.29/drivers/crypto/sfax8/Kconfig
```kconfig
#
# License terms: GNU General Public License (GPL) version 2
#
config CRYPTO_DEV_SFAX8_SHAM
		tristate "SFAX8 SHA1/SHA224/SHA256 and MD5 driver."
		depends on CRYPTO_DEV_SFAX8
		default n
		help
			This selecs the crypto driver for the SFAX8_SHAM hardware. It suppports
			SHA1,SHA224,SHA256 and MD5 algrithm.

config CRYPTO_DEV_SFAX8_CIPHER
		tristate "SFAX8 CIPHER driver"
		depends on CRYPTO_DEV_SFAX8
		default n
		help
			This selecs the crypto driver for the SFAX8_CIPHER hardware. It suppports
			AES,DES,TDES and  RC4 algrithm.
```

## linux-3.18.29-dev/linux-3.18.29/drivers/netlink/Kconfig
```kconfig
#
# Netlink subsystem configuration
#

menu "Netlink support"

config SFAX8_GENL
	tristate "Generic netlink socket"
	help
	  Use generic netlink socket to connect user space and kernel.

endmenu
```

## linux-3.18.29-dev/linux-3.18.29/sound/soc/siflower/Kconfig
```kconfig
config SND_SOC_SFAX8_PCM
		tristate "SoC PCM support for the Siflower SFAX8"
		select SND_SOC_GENERIC_DMAENGINE_PCM
		help 
		   Say Y or M if you want to add support for PCM interface 
		   You will also need to select the audio interfaces to support below.

config SND_SOC_SFAX8_I2S
		tristate "Siflower I2S Device Driver"
		select SND_SOC_GENERIC_DMAENGINE_PCM
		help
		   Say Y or M if you want to add support for I2S driver for
		   Siflower sfax8 I2S device. The device supports upto
		   maximum of 8 channels each for play and record.

config SND_SOC_SFAX8_SPDIF
		tristate "SoC spdif support for Siflower SFAx8 serials"
		select SND_SOC_GENERIC_DMAENGINE_PCM
		help 
		   Say Y or M if you want to add support for the spdif interface 
		   You will also need to select the audio interfaces to support below.

config SND_SOC_SFAX8_MACHINE
		tristate "SoC machine support for the Siflower SFAX8(PCM I2S)"
		help
			Say Y or M if you want to add support for machine

config SND_SOC_SFAX8_SPDIF_MACHINE
		tristate "SoC machine support for the Siflower SFAX8(SPDIF)"
		help
			Say Y or M if you want to add support for machine
```

## uboot/arch/mips/mach-sfax8/Kconfig
```kconfig
menu "Siflower SFAX8 platforms"
	depends on MACH_SFAX8

config SYS_SOC
	default "sfax8"

choice
	prompt "SOC select"

config SOC_SFA18_MPW0
	bool "SFA18 mpw0 soc"
	help
	  This supports Siflower sfa18 mpw0 SOC.

config SOC_SFA18_MPW1
	bool "SFA18 mpw1 soc"
	help
	  This supports Siflower sfa18 mpw1 SOC.

config SOC_SFA18_FULLMASK
	bool "SFA18 fullmask soc"
	help
	  This supports Siflower sfa18 full mask SOC.

config SOC_SF19A28_FULLMASK
	bool "SF19A28 fullmask soc"
	help
	  This supports Siflower sf19a28 fullmask SOC.
endchoice

choice
	prompt "Board select"

config TARGET_SFA18_P20B
	bool "SFA18 p20b board"

config TARGET_SFA18_P10M
	bool "SFA18 p10m board"

config TARGET_SFA18_X10
	bool "SFA18 x10 board"

config TARGET_SFA18_P10H
	bool "SFA18 p10h board"

config TARGET_SFA18_AC20_REALTEK
	bool "SFA18 ac20 realtek switch board"

config TARGET_SFA18_P10B
	bool "SFA18 p10b board"

config TARGET_SFA18_86V
	bool "SFA18 86V board"

config TARGET_SFA18_AC
	bool "SFA18 AC board"

config TARGET_SFA18_REP
	bool "SFA18 REP board"

config TARGET_SFA18_AIR001
	bool "SFA18 air001 board"

config TARGET_SF19A28_FPGA
	bool "SF19A28 FPGA board"
endchoice

source "board/siflower/sfa18_common/Kconfig"
source "arch/mips/mach-sfax8/pcba-test/Kconfig"

endmenu
```

## uboot/board/siflower/sf19a28_fpga/Kconfig
```kconfig
if TARGET_SF19A28_FPGA

config SYS_BOARD
	default "sf19a28_fpga"

config SYS_VENDOR
	default "siflower"

config SYS_CONFIG_NAME
	default "sfa18"

endif
```

## uboot/board/siflower/sfa18_ac20_realtek/Kconfig
```kconfig
if TARGET_SFA18_AC20_REALTEK

config SYS_BOARD
	default "sfa18_ac20_realtek"

config SYS_VENDOR
	default "siflower"

config SYS_CONFIG_NAME
	default "sfa18"

endif
```

## uboot/drivers/mtd/spi-nand/Kconfig
```kconfig
menu "SPI NAND Device Support"

config SPI_NAND
	bool "Enable SPI NAND flash support"
	depends on DM && DM_SPI
	select SPI_FLASH
	select DM_SPI_FLASH
	help
	  This option, if enabled, provides support of SPI NAND flash.

config SPI_NAND_MICRON
	bool "Support Micron SPI NAND flash"
	depends on SPI_NAND
	help
	  Enable support for the Micron SPI NAND flash.

config SPI_NAND_ICMAX
	bool "Support ICMAX SPI NAND flash"
	depends on SPI_NAND
	help
	  Enable support for the ICMAX SPI NAND flash.

endmenu
```
